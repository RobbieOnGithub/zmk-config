/*
 * Robbie Split - Left Half
 *
 * Rows (active low with pull-down):
 *   Row 1 = P1.00 (pin 100)
 *   Row 2 = P0.24 (pin 024)
 *   Row 3 = P0.22 (pin 022)
 *   Row 4 = P0.20 (pin 020)
 *   Row 5 = P0.17 (pin 017)
 *
 * Cols (active high, accent signal):
 *   Col 1 = P1.06 (pin 106) - possible broken trace, may need bodge wire
 *   Col 2 = P0.09 (pin 009)
 *   Col 3 = P1.15 (pin 115)
 *   Col 4 = P0.02 (pin 002)
 *   Col 5 = P0.29 (pin 029)
 *   Col 6 = P0.31 (pin 031)
 */

#include "robbie_split.dtsi"

/ {
    kscan0: kscan0 {
        compatible = "zmk,kscan-gpio-matrix";
        diode-direction = "col2row";
        wakeup-source;

        row-gpios
            = <&gpio1 0  (GPIO_ACTIVE_HIGH | GPIO_PULL_DOWN)>
            , <&gpio0 24 (GPIO_ACTIVE_HIGH | GPIO_PULL_DOWN)>
            , <&gpio0 22 (GPIO_ACTIVE_HIGH | GPIO_PULL_DOWN)>
            , <&gpio0 20 (GPIO_ACTIVE_HIGH | GPIO_PULL_DOWN)>
            , <&gpio0 17 (GPIO_ACTIVE_HIGH | GPIO_PULL_DOWN)>
            ;

        col-gpios
            = <&gpio1 6  GPIO_ACTIVE_HIGH>
            , <&gpio0 9  GPIO_ACTIVE_HIGH>
            , <&gpio1 15 GPIO_ACTIVE_HIGH>
            , <&gpio0 2  GPIO_ACTIVE_HIGH>
            , <&gpio0 29 GPIO_ACTIVE_HIGH>
            , <&gpio0 31 GPIO_ACTIVE_HIGH>
            ;
    };
};
