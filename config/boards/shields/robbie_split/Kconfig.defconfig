## config/boards/shields/robbie_split/Kconfig.defconfig
```kconfig
if SHIELD_ROBBIE_SPLIT_LEFT

config ZMK_KEYBOARD_NAME
    default "Robbie Split"

config ZMK_SPLIT_ROLE_CENTRAL
    default y

endif

if SHIELD_ROBBIE_SPLIT_LEFT || SHIELD_ROBBIE_SPLIT_RIGHT

config ZMK_SPLIT
    default y

endif
```

## config/boards/shields/robbie_split/Kconfig.shield
```kconfig
config SHIELD_ROBBIE_SPLIT_LEFT
    def_bool $(shields_list_contains,robbie_split_left)

config SHIELD_ROBBIE_SPLIT_RIGHT
    def_bool $(shields_list_contains,robbie_split_right)
```
